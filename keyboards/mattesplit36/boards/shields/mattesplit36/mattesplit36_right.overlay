#include "mattesplit36.dtsi"

&default_transform {
    col-offset = <18>;
};

&kscan0 {
    input-gpios =
        /* right top row, physical left-to-right */
        <&gpio0 11 (GPIO_ACTIVE_LOW | GPIO_PULL_UP)>,
        <&gpio1 4  (GPIO_ACTIVE_LOW | GPIO_PULL_UP)>,
        <&gpio0 9  (GPIO_ACTIVE_LOW | GPIO_PULL_UP)>,
        <&gpio1 13 (GPIO_ACTIVE_LOW | GPIO_PULL_UP)>,
        <&gpio1 7  (GPIO_ACTIVE_LOW | GPIO_PULL_UP)>,
        /* right middle row, physical left-to-right */
        <&gpio1 0  (GPIO_ACTIVE_LOW | GPIO_PULL_UP)>,
        <&gpio1 6  (GPIO_ACTIVE_LOW | GPIO_PULL_UP)>,
        <&gpio0 10 (GPIO_ACTIVE_LOW | GPIO_PULL_UP)>,
        <&gpio1 15 (GPIO_ACTIVE_LOW | GPIO_PULL_UP)>,
        <&gpio1 2  (GPIO_ACTIVE_LOW | GPIO_PULL_UP)>,
        /* right bottom row, physical left-to-right */
        <&gpio0 24 (GPIO_ACTIVE_LOW | GPIO_PULL_UP)>,
        <&gpio1 1  (GPIO_ACTIVE_LOW | GPIO_PULL_UP)>,
        <&gpio1 11 (GPIO_ACTIVE_LOW | GPIO_PULL_UP)>,
        <&gpio0 2  (GPIO_ACTIVE_LOW | GPIO_PULL_UP)>,
        <&gpio0 29 (GPIO_ACTIVE_LOW | GPIO_PULL_UP)>,
        /* right thumbs: P0.17 P0.20 P0.22 */
        <&gpio0 17 (GPIO_ACTIVE_LOW | GPIO_PULL_UP)>,
        <&gpio0 20 (GPIO_ACTIVE_LOW | GPIO_PULL_UP)>,
        <&gpio0 22 (GPIO_ACTIVE_LOW | GPIO_PULL_UP)>
    ;
};
