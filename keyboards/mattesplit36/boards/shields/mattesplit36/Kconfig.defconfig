## keyboards/mattesplit36/boards/shields/mattesplit36/Kconfig.defconfig
```kconfig
if SHIELD_MATTESPLIT36_LEFT || SHIELD_MATTESPLIT36_RIGHT_USB

config ZMK_KEYBOARD_NAME
    default "Mattesplit36"

config ZMK_SPLIT_ROLE_CENTRAL
    default y

endif

if SHIELD_MATTESPLIT36_LEFT || SHIELD_MATTESPLIT36_RIGHT || SHIELD_MATTESPLIT36_RIGHT_USB

config ZMK_SPLIT
    default y

endif
```

## keyboards/mattesplit36/boards/shields/mattesplit36/Kconfig.shield
```kconfig
config SHIELD_MATTESPLIT36_LEFT
    def_bool $(shields_list_contains,mattesplit36_left)

config SHIELD_MATTESPLIT36_RIGHT
    def_bool $(shields_list_contains,mattesplit36_right)

config SHIELD_MATTESPLIT36_RIGHT_USB
    def_bool $(shields_list_contains,mattesplit36_right_usb)
```
